## CMakeLists.txt
```
# SPDX-License-Identifier: Apache-2.0

cmake_minimum_required(VERSION 3.13.1)

find_package(Zephyr REQUIRED HINTS $ENV{ZEPHYR_BASE})
project(hello_world)

target_include_directories(app PRIVATE 
    ${ZEPHYR_BASE}/include/portability
    includes
    pldm
)

file(GLOB ALL_SRC
    src/*.c
    mctp/*.c
    pldm/*.c)

target_sources(app
PRIVATE
    ${ALL_SRC}
)
```

## prj.conf
```kconfig
# nothing here
# CONFIG_HAS_CMSIS_CORE=y
# CONFIG_HAS_CMSIS_CORE_M=y
CONFIG_LOG=y
CONFIG_LOG_DEFAULT_LEVEL=4
CONFIG_LOG_RUNTIME_FILTERING=y
CONFIG_LOG_MODE_DEFERRED=n

CONFIG_CMSIS_RTOS_V2=y
CONFIG_NUM_PREEMPT_PRIORITIES=56
#CONFIG_HEAP_MEM_POOL_SIZE=16384
#CONFIG_CMSIS_V2_MSGQ_MAX_DYNAMIC_SIZE=32768
CONFIG_HEAP_MEM_POOL_SIZE=32768
CONFIG_CMSIS_V2_MSGQ_MAX_DYNAMIC_SIZE=16384
CONFIG_POLL=y
CONFIG_THREAD_NAME=y
CONFIG_THREAD_STACK_INFO=y
CONFIG_THREAD_MONITOR=y
CONFIG_IRQ_OFFLOAD=y
CONFIG_INIT_STACKS=y
CONFIG_MAX_THREAD_BYTES=4
CONFIG_SCHED_SCALABLE=y
CONFIG_CMSIS_V2_MEM_SLAB_MAX_DYNAMIC_SIZE=128
CONFIG_CMSIS_V2_THREAD_MAX_COUNT=23
CONFIG_CMSIS_V2_THREAD_DYNAMIC_MAX_COUNT=10
CONFIG_TIMEOUT_64BIT=n
CONFIG_CMSIS_V2_THREAD_MAX_STACK_SIZE=8000
CONFIG_CMSIS_V2_THREAD_DYNAMIC_STACK_SIZE=3000
CONFIG_MP_NUM_CPUS=1

CONFIG_SYS_CLOCK_TICKS_PER_SEC=1000

CONFIG_NEWLIB_LIBC=y
```

## src/main.c
```c
/*
 * Copyright (c) 2012-2014 Wind River Systems, Inc.
 *
 * SPDX-License-Identifier: Apache-2.0
 */

#include <zephyr.h>
#include <sys/printk.h>
#include <cmsis_os2.h>
#include <logging/log.h>
#include <logging/log_ctrl.h>
#include "mctp.h"
#include "pldm.h"

LOG_MODULE_REGISTER(mctp_test);

#define MCTP_SMBUS_NUM 1

#define MCTP_MSG_TYPE_SHIFT 0
#define MCTP_MSG_TYPE_MASK 0x7F
#define MCTP_IC_SHIFT 7
#define MCTP_IC_MASK 0x80

typedef struct _mctp_smbus_port {
	mctp *mctp_inst;
	mctp_medium_conf conf;
} mctp_smbus_port;

/* mctp route entry struct */
typedef struct _mctp_route_entry {
    uint8_t endpoint;
    uint8_t bus; /* TODO: only consider smbus/i3c */
    uint8_t addr; /* TODO: only consider smbus/i3c */
} mctp_route_entry;

typedef struct _mctp_msg_handler {
	MCTP_MSG_TYPE type;
	mctp_fn_cb msg_handler_cb;
} mctp_msg_handler;

static mctp_msg_handler cmd_tbl[] = {
	{MCTP_MSG_TYPE_PLDM, mctp_pldm_cmd_handler}
};

static mctp_smbus_port smbus_port[MCTP_SMBUS_NUM] = {
	{.conf.smbus_conf.addr = 0xB2, .conf.smbus_conf.bus = 0x01},
	// {.conf.smbus_conf.addr = 0x20, .conf.smbus_conf.bus = 0x02}
};

mctp_route_entry mctp_route_tbl[] = {
	{0x11, 0x01, 0x41},
	{0x12, 0x02, 0x42},
	{0x13, 0x01, 0x43},
	{0x14, 0x02, 0x44},
	{0x15, 0x01, 0x45},
	{0x16, 0x02, 0x46}
};

static mctp *find_mctp_by_smbus(uint8_t bus)
{
	uint8_t i;
	for (i = 0; i < MCTP_SMBUS_NUM; i++) {
		mctp_smbus_port *p = smbus_port + i;
		
		if (bus == p->conf.smbus_conf.bus)
			return p->mctp_inst;
	}

	return NULL;
}

uint8_t mctp_control_cmd_handler(void *mctp_p, uint8_t src_ep, uint8_t *buf, uint32_t len, mctp_ext_param ext_params)
{
	mctp_printf("\n");
	if (!mctp_p || !buf || !len)
		return MCTP_ERROR;

	return MCTP_SUCCESS;
}

static uint8_t mctp_msg_recv(void *mctp_p, uint8_t *buf, uint32_t len, mctp_ext_param ext_params)
{
	if (!mctp_p || !buf || !len)
		return MCTP_ERROR;
	
	/* first byte is message type and ic */
	uint8_t msg_type = (buf[0] & MCTP_MSG_TYPE_MASK) >> MCTP_MSG_TYPE_SHIFT;
	uint8_t ic = (buf[0] & MCTP_IC_MASK) >> MCTP_IC_SHIFT;
	(void)ic;
	
	uint8_t i;
	for (i = 0; i < sizeof(cmd_tbl) / sizeof(*cmd_tbl); i++) {
		if (cmd_tbl[i].type == msg_type) {
			cmd_tbl[i].msg_handler_cb(mctp_p, buf, len, ext_params);
			break;
		}
	}

	return MCTP_SUCCESS;
}

static uint8_t get_route_info(uint8_t dest_endpoint, void **mctp_inst, mctp_ext_param *ext_params)
{
	if (!mctp_inst || !ext_params)
		return MCTP_ERROR;

	uint8_t rc = MCTP_ERROR;
	uint32_t i;

	for (i = 0; ARRAY_SIZE(mctp_route_tbl); i++) {
		mctp_route_entry *p = mctp_route_tbl + i;
		if (p->endpoint == dest_endpoint) {
			*mctp_inst = find_mctp_by_smbus(p->bus);
			ext_params->type = MCTP_MEDIUM_TYPE_SMBUS;
			ext_params->smbus_ext_param.addr = p->addr;
			rc = MCTP_SUCCESS;
			break;
		}
	}

	return rc;
}

static void main_gettid(void *args, uint8_t *buf, uint16_t len)
{
	LOG_DBG("");
}

static void to_test(void *to_args)
{
	uint8_t *i = (uint8_t *)to_args;
	LOG_DBG("*i = %d", *i);
}

void main(void)
{
	LOG_DBG("MCTP test");

	uint32_t i;
	for (i = 0; i < MCTP_SMBUS_NUM; i++) {
		mctp_smbus_port *p = smbus_port + i;
		LOG_DBG("smbus port %d", i);
		LOG_DBG("bus = %x, addr = %x", p->conf.smbus_conf.bus, p->conf.smbus_conf.addr);

		p->mctp_inst = mctp_init();
		if (!p->mctp_inst) {
			LOG_ERR("mctp_init failed!!");
			continue;
		}

		uint8_t rc = mctp_set_medium_configure(p->mctp_inst, MCTP_MEDIUM_TYPE_SMBUS, p->conf);
		LOG_DBG("mctp_set_medium_configure %s", (rc == MCTP_SUCCESS)? "success": "failed");

		/* test get medium function */
		MCTP_MEDIUM_TYPE medium_type = MCTP_MEDIUM_TYPE_UNKNOWN;
		mctp_medium_conf medium_conf;
		rc = mctp_get_medium_configure(p->mctp_inst, &medium_type, &medium_conf);
		LOG_DBG("mctp_get_medium_configure %s", (rc == MCTP_SUCCESS)? "success": "failed");
		LOG_DBG("medium_type = %d", medium_type);
		LOG_DBG("smbus bus = %x, addr = %x", medium_conf.smbus_conf.bus, medium_conf.smbus_conf.addr);

		mctp_reg_endpoint_resolve_func(p->mctp_inst, get_route_info);
		mctp_reg_msg_rx_func(p->mctp_inst, mctp_msg_recv);
		mctp_start(p->mctp_inst);
	}

	pldm_init();

	while (1) {
		k_msleep(1000);

		mctp_ext_param ext_param = {0};
		ext_param.type = MCTP_MEDIUM_TYPE_SMBUS;
		ext_param.smbus_ext_param.addr = 0x80;
		ext_param.ep = 0x78;

		pldm_msg msg = {0};
		msg.hdr.pldm_type = PLDM_TYPE_BASE;
		msg.hdr.cmd = PLDM_BASE_CMD_CODE_GETTID;
		msg.hdr.rq = 1;
#if 1
		// mctp_pldm_send_msg(smbus_port[0].mctp_inst, &msg, ext_param, main_gettid, NULL);
		static uint8_t i = 78;
		mctp_pldm_send_msg_with_timeout(smbus_port[0].mctp_inst, &msg, ext_param, main_gettid, NULL, 5000, to_test, &i);
		i++;
#endif
#if 0
		if (!(i % 1000)) {
			uint8_t buf[] = {0x01,0x00,0x05,0x15,0x00,0x22,0x00,0x00,0xEA,
				0x03,0xA5,0xEA,0x5A,0xA5,0xEA,0x5A,0xA5,0xEA,0x5A,0xA5,0x5A,0x77,0x46,0x74,0x41,
				0x28,0x00,0x00,0x00,0xE5,0xD0,0xE4,0xDC,0x00,0x02,0x02,0x91,0x01,0x00,0xFF,0xFF,
				0x00,0x00,0xFF,0xFF,0xFF,0xFF,0xFF,0xFF,0x3C,0x00,0x00,0x00,0xC0,0xD8,0x06,0x00,
				0x7C,0x05,0x00,0x00,0xC0,0xD8,0x06,0x00,0x64
			};
			mctp_ext_param ext_param = {0};
			ext_param.type = MCTP_MEDIUM_TYPE_SMBUS;
			ext_param.smbus_ext_param.addr = 0x80;

			ext_param.msg_tag = 0;
			ext_param.tag_owner = 1;
			ext_param.ep = 6;

			mctp_send_msg(smbus_port[0].mctp_inst, buf, sizeof(buf), ext_param);
		}

		if (!(i % 2000)) {
			uint8_t buf[] = {0x01,0x00,0x05,0x15,0x00,0x22,0x00,0x00,0xEA,
				0x03,0xA5,0xEA,0x5A,0xA5,0xEA,0x5A,0xA5,0xEA,0x5A,0xA5,0x5A,0x77,0x46,0x74,0x41,
				0x28,0x00,0x00,0x00,0xE5,0xD0,0xE4,0xDC,0x00,0x02,0x02,0x91,0x01,0x00,0xFF,0xFF,
				0x00,0x00,0xFF,0xFF,0xFF,0xFF,0xFF,0xFF,0x3C,0x00,0x00,0x00,0xC0,0xD8,0x06,0x00,
				0x7C,0x05,0x00,0x00,0xC0,0xD8,0x06,0x00,0x65,0x01,0x00,0x05,0x15,0x00,0x22,0x00,0x00,0xEA,
				0x03,0xA5,0xEA,0x5A,0xA5,0xEA,0x5A,0xA5,0xEA,0x5A,0xA5,0x5A,0x77,0x46,0x74,0x41,
				0x28,0x00,0x00,0x00,0xE5,0xD0,0xE4,0xDC,0x00,0x02,0x02,0x91,0x01,0x00,0xFF,0xFF,
				0x00,0x00,0xFF,0xFF,0xFF,0xFF,0xFF,0xFF,0x3C,0x00,0x00,0x00,0xC0,0xD8,0x06,0x00,
				0x7C,0x05,0x00,0x00,0xC0,0xD8,0x06,0x00,0x65,0x01,0x00,0x05,0x15,0x00,0x22,0x00,0x00,0xEA,
				0x03,0xA5,0xEA,0x5A,0xA5,0xEA,0x5A,0xA5,0xEA,0x5A,0xA5,0x5A,0x77,0x46,0x74,0x41,
				0x28,0x00,0x00,0x00,0xE5,0xD0,0xE4,0xDC,0x00,0x02,0x02,0x91,0x01,0x00,0xFF,0xFF,
				0x00,0x00,0xFF,0xFF,0xFF,0xFF,0xFF,0xFF,0x3C,0x00,0x00,0x00,0xC0,0xD8,0x06,0x00,
				0x7C,0x05,0x00,0x00,0xC0,0xD8,0x06,0x00,0x65,0x01,0x00,0x05,0x15,0x00,0x22,0x00,0x00,0xEA,
				0x03,0xA5,0xEA,0x5A,0xA5,0xEA,0x5A,0xA5,0xEA,0x5A,0xA5,0x5A,0x77,0x46,0x74,0x41,
				0x28,0x00,0x00,0x00,0xE5,0xD0,0xE4,0xDC,0x00,0x02,0x02,0x91,0x01,0x00,0xFF,0xFF,
				0x00,0x00,0xFF,0xFF,0xFF,0xFF,0xFF,0xFF,0x3C,0x00,0x00,0x00,0xC0,0xD8,0x06,0x00,
				0x7C,0x05,0x00,0x00,0xC0,0xD8,0x06,0x00,0x65
			};
			mctp_ext_param ext_param = {0};
			ext_param.type = MCTP_MEDIUM_TYPE_SMBUS;
			ext_param.smbus_ext_param.addr = 0x60;

			ext_param.msg_tag = 0;
			ext_param.tag_owner = 1;
			ext_param.ep = 7;

			mctp_send_msg(smbus_port[0].mctp_inst, buf, sizeof(buf), ext_param);
		}
#endif
	}
}
```

## src/mctp.c
```c
#include <stdint.h>
#include <stdlib.h>
#include <stdio.h>
#include <string.h>
#include <zephyr.h>
#include <sys/printk.h>
#include <cmsis_os2.h>
#include "mctp.h"

#define MCTP_DEFAULT_THREAD_STACK_SIZE 0x1000
#define MCTP_DEFAULT_THREAD_PRIORITY osPriorityNormal
#define MCTP_TX_QUEUE_SIZE 16

#define MCTP_HDR_HDR_VER 0x01
#define MCTP_HDR_SEQ_MASK 0x03
#define MCTP_HDR_TAG_MASK 0x07

#define MSG_ASSEMBLY_BUF_SIZE 1024

typedef struct __attribute__((packed)) {
    uint8_t hdr_ver;
    uint8_t dest_ep;
    uint8_t src_ep;
    union {
        struct {
            uint8_t msg_tag : 3;
            uint8_t to : 1;
            uint8_t pkt_seq : 2;
            uint8_t eom : 1;
            uint8_t som : 1;
        };
        uint8_t flags_seq_to_tag;
    };
} mctp_hdr;

/* set thread name */
static uint8_t set_thread_name(mctp *mctp_inst)
{
    if (!mctp_inst)
        return MCTP_ERROR;

    if (mctp_inst->medium_type <= MCTP_MEDIUM_TYPE_UNKNOWN || mctp_inst->medium_type >= MCTP_MEDIUM_TYPE_MAX)
        return MCTP_ERROR;

    if (mctp_inst->medium_type == MCTP_MEDIUM_TYPE_SMBUS) {
        mctp_smbus_conf *smbus_conf = (mctp_smbus_conf *)&mctp_inst->medium_conf;
        snprintf(mctp_inst->mctp_rx_task_name, sizeof(mctp_inst->mctp_rx_task_name), 
            "mctprx_%02x_%02x_%02x", mctp_inst->medium_type, smbus_conf->bus, smbus_conf->addr);
        snprintf(mctp_inst->mctp_tx_task_name, sizeof(mctp_inst->mctp_tx_task_name), 
            "mctptx_%02x_%02x_%02x", mctp_inst->medium_type, smbus_conf->bus, smbus_conf->addr);
    }

    return MCTP_SUCCESS;
}

/* init the medium related resources */
static uint8_t mctp_medium_init(mctp *mctp_inst, mctp_medium_conf medium_conf)
{
    if (!mctp_inst)
        return MCTP_ERROR;

    uint8_t rc = MCTP_ERROR;
    switch (mctp_inst->medium_type) {
    case MCTP_MEDIUM_TYPE_SMBUS:
        rc = mctp_smbus_init(mctp_inst, medium_conf);
        break;
    default:
        break;
    }

    return rc;
}

static uint8_t mctp_medium_deinit(mctp *mctp_inst)
{
    if (!mctp_inst)
        return MCTP_ERROR;

    switch (mctp_inst->medium_type) {
    case MCTP_MEDIUM_TYPE_SMBUS:
        mctp_smbus_deinit(mctp_inst);
        break;
    default:
        break;
    }

    return MCTP_SUCCESS;
}

static uint8_t bridge_msg(mctp *mctp_inst, uint8_t *buf, uint16_t len)
{
    if (!mctp_inst || !buf || !len)
        return MCTP_ERROR;

    if (!mctp_inst->ep_resolve)
        return MCTP_ERROR;
    
    mctp *target_mctp = NULL;
    mctp_ext_param target_ext_params;
    memset(&target_ext_params, 0, sizeof(target_ext_params));

    mctp_hdr *hdr = (mctp_hdr *)buf;
    uint8_t rc = mctp_inst->ep_resolve(hdr->dest_ep, (void **)&target_mctp, &target_ext_params);
    if (rc != MCTP_SUCCESS) {
        mctp_printf("can't bridge endpoint %x\n", hdr->dest_ep);
        return MCTP_ERROR;
    }

    mctp_printf("rc = %d, bridget msg to mctp = %p\n", rc, target_mctp);
    mctp_bridge_msg(target_mctp, buf, len, target_ext_params);
    return MCTP_SUCCESS;
}

static uint8_t mctp_pkt_assembling(mctp *mctp_inst, uint8_t *buf, uint16_t len)
{
    if (!mctp_inst || !buf || !len)
        return MCTP_ERROR;

    mctp_hdr *hdr = (mctp_hdr *)buf;
    uint8_t **buf_p = &mctp_inst->temp_msg_buf[hdr->msg_tag].buf;
    uint16_t *ofs_p = &mctp_inst->temp_msg_buf[hdr->msg_tag].ofs;
    
    /* one packet msg, do nothing */
    if (hdr->som && hdr->eom)
        return MCTP_SUCCESS;

    if (hdr->som && !hdr->eom) { /* first packet, alloc memory to hold data */
        if (*buf_p)
            free(*buf_p);
        *ofs_p = 0;

        *buf_p = (uint8_t *)k_malloc(MSG_ASSEMBLY_BUF_SIZE);
        printk("*buf_p = %p\n", *buf_p);
        if (!*buf_p) {
            mctp_printf("cannot create memory...\n");
            return MCTP_ERROR;
        }
        memset(*buf_p, 0, MSG_ASSEMBLY_BUF_SIZE);
    }

    printk("*buf_p + *ofs_p = %p\n", *buf_p + *ofs_p);
    memcpy(*buf_p + *ofs_p, buf + sizeof(hdr), len - sizeof(hdr));
    *ofs_p += len - sizeof(hdr);

    mctp_printf("*ofs_p = %d\n", *ofs_p);
    return MCTP_SUCCESS;
}

/* mctp rx task */
static void mctp_rx_task(void *arg)
{
    if (!arg) {
        mctp_printf("mctp_rx_task without mctp_inst!\n");
        return;
    }
    
    mctp *mctp_inst = (mctp *)arg;
    if (!mctp_inst->read_data) {
        mctp_printf("mctp_rx_task without medium read function!\n");
        return;
    }

    mctp_printf("mctp_rx_task start %p!\n", mctp_inst);
    while (1) {
        k_msleep(1000);

        uint8_t read_buf[256] = {0};
        mctp_ext_param ext_param;
        memset(&ext_param, 0, sizeof(ext_param));
        uint16_t read_len = mctp_inst->read_data(mctp_inst, read_buf, sizeof(read_buf), &ext_param);
        if (!read_len)
            continue;

        if (0)
            print_data_hex(read_buf, read_len);

        mctp_hdr *hdr = (mctp_hdr *)read_buf;
        mctp_printf("dest_ep = %x, src_ep = %x, flags = %x\n", hdr->dest_ep, hdr->src_ep, hdr->flags_seq_to_tag);

        /* set the tranport layer extra parameters */
        ext_param.msg_tag = hdr->msg_tag;
        ext_param.tag_owner = 0; /* the high-level application won't modify the tag_owner flag,
                                    change the tag_owner for response if needs */
        ext_param.ep = hdr->src_ep;

        if (hdr->dest_ep != mctp_inst->endpoint) {
            /* try to bridge this packet */
            bridge_msg(mctp_inst, read_buf, read_len);
            continue;
        }

        /* handle this packet by self */

        /* assembling the mctp message */
        mctp_pkt_assembling(mctp_inst, read_buf, read_len);

        /* if it is not last packet, waiting for the remain data */
        if (!hdr->eom)
            continue;

        if (mctp_inst->rx_cb) {
            uint8_t *p = read_buf + sizeof(hdr); /* default process read data buffer directly */
            uint16_t len = read_len - sizeof(hdr);
            
            if (mctp_inst->temp_msg_buf[hdr->msg_tag].buf) { /* this is assembly message */
                p = mctp_inst->temp_msg_buf[hdr->msg_tag].buf;
                len = mctp_inst->temp_msg_buf[hdr->msg_tag].ofs;

                print_data_hex(p, len);
            }

            /* handle the mctp messsage */
            mctp_inst->rx_cb(mctp_inst, p, len, ext_param);
        }

        if (mctp_inst->temp_msg_buf[hdr->msg_tag].buf) {
            k_free(mctp_inst->temp_msg_buf[hdr->msg_tag].buf);
            mctp_inst->temp_msg_buf[hdr->msg_tag].buf = NULL;
        }

        if (mctp_inst->temp_msg_buf[hdr->msg_tag].ofs)
            mctp_inst->temp_msg_buf[hdr->msg_tag].ofs = 0;
    }
}

/* mctp tx task */
static void mctp_tx_task(void *arg)
{
    if (!arg) {
        mctp_printf("mctp_tx_task without mctp_inst!\n");
        return;
    }
    
    mctp *mctp_inst = (mctp *)arg;

    if (!mctp_inst->mctp_tx_queue) {
        mctp_printf("mctp_tx_task without mctp_tx_queue!\n");
        return;
    }

    if (!mctp_inst->write_data) {
        mctp_printf("mctp_tx_task without medium write function!\n");
        return;
    }

    mctp_printf("mctp_tx_task start %p!\n", mctp_inst);
    while (1) {
        mctp_tx_msg mctp_msg = {0};
        osStatus_t rc = osMessageQueueGet(mctp_inst->mctp_tx_queue, &mctp_msg, NULL, osWaitForever);
        if (rc != osOK)
            continue;

        if (!mctp_msg.buf)
            continue;

        if (!mctp_msg.len) {
            k_free(mctp_msg.buf);
            continue;
        }

        if (0) {
            mctp_printf("tx endpoint %x\n", mctp_msg.ext_param.ep);
            print_data_hex(mctp_msg.buf, mctp_msg.len);
        }

        /* bridge meesage alread has the mctp transport header, so doesn't need to make header */
        /* bridge message also doesn't need to split packet */
        if (mctp_msg.is_bridge_packet) {
            mctp_inst->write_data(mctp_inst, mctp_msg.buf, mctp_msg.len, mctp_msg.ext_param);
            k_free(mctp_msg.buf);
            continue;
        }

        /* set up MCTP header and send to destination endpoint */
        static uint8_t msg_tag;
        uint16_t max_msg_size = mctp_inst->max_msg_size;
        uint8_t i;
        uint8_t split_pkt_num = (mctp_msg.len / max_msg_size) + ((mctp_msg.len % max_msg_size)? 1: 0);
        mctp_printf("mctp_msg.len = %d\n", mctp_msg.len);
        mctp_printf("split_pkt_num = %d\n", split_pkt_num);
        for (i = 0; i < split_pkt_num; i++) {
            uint8_t buf[max_msg_size + MCTP_TRANSPORT_HEADER_SIZE];
            mctp_hdr *hdr = (mctp_hdr *)buf;
            uint8_t cp_msg_size = max_msg_size;

            memset(buf, 0, sizeof(buf));

            /* first packet should set SOM */
            if (!i)
                hdr->som = 1;

            /* last packet should set EOM */
            if (i == (split_pkt_num - 1)) {
                hdr->eom = 1;
                uint8_t remain = mctp_msg.len % max_msg_size;
                cp_msg_size = remain? remain: max_msg_size; /* remain data */
            }

            hdr->to = mctp_msg.ext_param.tag_owner;
            hdr->pkt_seq = i & MCTP_HDR_SEQ_MASK;

            /* TODO: should avoid the msg_tag if there are pending mctp response packets? */
            hdr->msg_tag = msg_tag & MCTP_HDR_TAG_MASK;

            hdr->dest_ep = mctp_msg.ext_param.ep;
            hdr->src_ep = mctp_inst->endpoint;
            hdr->hdr_ver = MCTP_HDR_HDR_VER;

            mctp_printf("i = %d, cp_msg_size = %d\n", i, cp_msg_size);
            mctp_printf("hdr->flags_seq_to_tag = %x\n", hdr->flags_seq_to_tag);
            memcpy(buf + MCTP_TRANSPORT_HEADER_SIZE, mctp_msg.buf + i * max_msg_size, cp_msg_size);
            mctp_inst->write_data(mctp_inst, buf, cp_msg_size + MCTP_TRANSPORT_HEADER_SIZE, mctp_msg.ext_param);
        }

        k_free(mctp_msg.buf);
        
        /* only request mctp message needs to increase msg_tag */
        if (mctp_msg.ext_param.tag_owner)
            msg_tag++;
    }
}

/* mctp handle initial */
mctp *mctp_init(void)
{
    mctp *mctp_inst = (mctp *)k_malloc(sizeof(*mctp_inst));
    
    if (!mctp_inst)
        return NULL;

    memset(mctp_inst, 0, sizeof(*mctp_inst));
    mctp_inst->medium_type = MCTP_MEDIUM_TYPE_UNKNOWN;
    mctp_inst->max_msg_size = MCTP_DEFAULT_MSG_MAX_SIZE;
    mctp_inst->endpoint = MCTP_DEFAULT_ENDPOINT;

    if (MCTP_DEBUG)
        mctp_printf("mctp_inst = %p\n", mctp_inst);
    return mctp_inst;
}

/* mctp handle deinitial */
uint8_t mctp_deinit(mctp *mctp_inst)
{
    if (!mctp_inst)
        return MCTP_ERROR;

    if (MCTP_DEBUG)
        mctp_printf("mctp_inst = %p\n", mctp_inst);

    mctp_stop(mctp_inst);
    mctp_medium_deinit(mctp_inst);
    
    k_free(mctp_inst);
    return MCTP_SUCCESS;
}

/* configure mctp handle with specific medium type */
uint8_t mctp_set_medium_configure(mctp *mctp_inst, MCTP_MEDIUM_TYPE medium_type, mctp_medium_conf medium_conf)
{
    if (!mctp_inst)
        return MCTP_ERROR;

    if (medium_type <= MCTP_MEDIUM_TYPE_UNKNOWN || medium_type >= MCTP_MEDIUM_TYPE_MAX)
        return MCTP_ERROR;

    mctp_inst->medium_type = medium_type;
    if (mctp_medium_init(mctp_inst, medium_conf) == MCTP_ERROR)
        goto error;
    return MCTP_SUCCESS;

error:
    mctp_medium_deinit(mctp_inst);
    mctp_inst->medium_type = MCTP_MEDIUM_TYPE_UNKNOWN;
    return MCTP_ERROR;
}

uint8_t mctp_get_medium_configure(mctp *mctp_inst, MCTP_MEDIUM_TYPE *medium_type, mctp_medium_conf *medium_conf)
{
    if (!mctp_inst || !medium_type || !medium_conf)
        return MCTP_ERROR;

    *medium_type = mctp_inst->medium_type;
    *medium_conf = mctp_inst->medium_conf;
    return MCTP_SUCCESS;
}

uint8_t mctp_stop(mctp *mctp_inst)
{
    if (!mctp_inst)
        return MCTP_ERROR;

    if (mctp_inst->mctp_rx_task_tid) {
        osThreadTerminate(mctp_inst->mctp_rx_task_tid);
        mctp_inst->mctp_rx_task_tid = NULL;
    }

    if (mctp_inst->mctp_tx_task_tid) {
        osThreadTerminate(mctp_inst->mctp_tx_task_tid);
        mctp_inst->mctp_tx_task_tid = NULL;
    }

    if (!mctp_inst->mctp_tx_queue) {
        osMessageQueueDelete(mctp_inst->mctp_tx_queue);
        mctp_inst->mctp_tx_queue = NULL;
    }

    mctp_inst->is_servcie_start = 0;
    return MCTP_SUCCESS;
}

uint8_t mctp_start(mctp *mctp_inst)
{
    if (!mctp_inst)
        return MCTP_ERROR;
    
    if (mctp_inst->is_servcie_start) {
        mctp_printf("The mctp_inst is already start!\n");
        return MCTP_ERROR;
    }

    set_thread_name(mctp_inst);
    mctp_inst->mctp_tx_queue = osMessageQueueNew(MCTP_TX_QUEUE_SIZE, sizeof(mctp_tx_msg), NULL);
    if (!mctp_inst->mctp_tx_queue)
        goto error;

    osThreadAttr_t thread_attr = {0};
    /* create rx service */

    /* the name len of osThreadAttr_t is only 16 bytes */
    thread_attr.name = (const char *)mctp_inst->mctp_rx_task_name;
    thread_attr.priority = MCTP_DEFAULT_THREAD_PRIORITY;
    thread_attr.stack_size = MCTP_DEFAULT_THREAD_STACK_SIZE;
    mctp_inst->mctp_rx_task_tid = osThreadNew(mctp_rx_task, (void *)mctp_inst, &thread_attr);
    if (!mctp_inst->mctp_rx_task_tid)
        goto error;
    
    /* let the thread can be terminated by osThreadTerminate */
    osThreadDetach(mctp_inst->mctp_rx_task_tid);
    
    mctp_printf("mctp_inst->mctp_rx_task_tid = %p\n", mctp_inst->mctp_rx_task_tid);

    /* create tx service */
    thread_attr.name = (const char *)mctp_inst->mctp_tx_task_name;
    mctp_inst->mctp_tx_task_tid = osThreadNew(mctp_tx_task, (void *)mctp_inst, &thread_attr);
    if (!mctp_inst->mctp_tx_task_tid)
        goto error;
    osThreadDetach(mctp_inst->mctp_tx_task_tid);
    
    mctp_printf("mctp_inst->mctp_tx_task_tid = %p\n", mctp_inst->mctp_tx_task_tid);
    
    mctp_inst->is_servcie_start = 1;
    return MCTP_SUCCESS;

error:
    mctp_printf("mctp_start failed!!\n");
    mctp_stop(mctp_inst);
    return MCTP_ERROR;
}

uint8_t mctp_bridge_msg(mctp *mctp_inst, uint8_t *buf, uint16_t len, mctp_ext_param ext_param)
{
    if (!mctp_inst || !buf || !len)
        return MCTP_ERROR;
    
    if (!mctp_inst->is_servcie_start || !mctp_inst->mctp_tx_queue) {
        mctp_printf("The mctp_inst isn't start service!\n");
        return MCTP_ERROR;
    }

    mctp_tx_msg mctp_msg = {0};
    mctp_msg.is_bridge_packet = 1;
    mctp_msg.len = len;
    mctp_msg.buf = (uint8_t *)k_malloc(len);
    if (!mctp_msg.buf)
        goto error;
    memcpy(mctp_msg.buf, buf, len);

    mctp_printf("sizeof(ext_param) = %d\n", sizeof(ext_param));
    mctp_msg.ext_param = ext_param;

    osStatus_t rc = osMessageQueuePut(mctp_inst->mctp_tx_queue, &mctp_msg, 0, 0);
    return (rc == osOK)? MCTP_SUCCESS: MCTP_ERROR;

error:
    if (mctp_msg.buf)
        k_free(mctp_msg.buf);

    return MCTP_ERROR;
}

uint8_t mctp_send_msg(mctp *mctp_inst, uint8_t *buf, uint16_t len, mctp_ext_param ext_param)
{
    if (!mctp_inst || !buf || !len)
        return MCTP_ERROR;
    
    if (!mctp_inst->is_servcie_start || !mctp_inst->mctp_tx_queue) {
        mctp_printf("The mctp_inst isn't start service!\n");
        return MCTP_ERROR;
    }

    mctp_tx_msg mctp_msg = {0};
    mctp_msg.len = len;
    mctp_msg.buf = (uint8_t *)k_malloc(len);
    if (!mctp_msg.buf)
        goto error;
    memcpy(mctp_msg.buf, buf, len);

    mctp_printf("sizeof(ext_param) = %d\n", sizeof(ext_param));
    mctp_msg.ext_param = ext_param;

    osStatus_t rc = osMessageQueuePut(mctp_inst->mctp_tx_queue, &mctp_msg, 0, 0);
    return (rc == osOK)? MCTP_SUCCESS: MCTP_ERROR;

error:
    if (mctp_msg.buf)
        k_free(mctp_msg.buf);

    return MCTP_ERROR;
}

uint8_t mctp_reg_endpoint_resolve_func(mctp *mctp_inst, endpoint_resolve resolve_fn)
{
    if (!mctp_inst || !resolve_fn)
        return MCTP_ERROR;

    mctp_inst->ep_resolve = resolve_fn;
    return MCTP_SUCCESS;
}

uint8_t mctp_reg_msg_rx_func(mctp *mctp_inst, mctp_fn_cb rx_cb)
{
    if (!mctp_inst || !rx_cb)
        return MCTP_ERROR;

    mctp_inst->rx_cb = rx_cb;
    return MCTP_SUCCESS;
}
```

## src/mctp.h
```c
#ifndef _MCTP_H
#define _MCTP_H

#ifdef __cplusplus
extern "C" {
#endif

#include <stdint.h>
#include <sys/printk.h>
#include <zephyr.h>
#include <cmsis_os2.h>

#define MCTP_DEBUG 1

#define MCTP_SUCCESS 0
#define MCTP_ERROR 1

#define MCTP_TASK_NAME_LEN 32
#define MCTP_DEFAULT_MSG_MAX_SIZE 64
#define MCTP_DEFAULT_ENDPOINT 0x68

#define MCTP_TRANSPORT_HEADER_SIZE 4
#define MCTP_MEDIUM_META_SIZE_SMBUS 3
#define MCTP_PEC_SIZE 1 /* SMBUS/I3C */
#define MCTP_META_INFO_SIZE (MCTP_TRANSPORT_HEADER_SIZE + MCTP_PEC_SIZE)

#define mctp_printf(format, s...) \
	do { \
        if (MCTP_DEBUG) \
		    printk("[%lld][%s::%s::%d]" format, k_uptime_get(), __FILE__, __func__, __LINE__, ## s); \
	} while (0)

typedef enum {
    MCTP_MEDIUM_TYPE_UNKNOWN = 0,
    MCTP_MEDIUM_TYPE_SMBUS,
    MCTP_MEDIUM_TYPE_I3C,
    MCTP_MEDIUM_TYPE_MAX
} MCTP_MEDIUM_TYPE;

/* smbus extra medium data of endpoint */
typedef struct _mctp_i3c_ext_param {
    uint8_t addr;
    uint32_t dummy; // TODO: test only
} mctp_i3c_ext_param;

/* smbus extra medium data of endpoint */
typedef struct _mctp_smbus_ext_param {
    uint8_t addr;
} mctp_smbus_ext_param;

/* medium extra parameters prototype */
typedef struct _mctp_medium_ext_param {
    MCTP_MEDIUM_TYPE type;
    union {
        mctp_smbus_ext_param smbus_ext_param;
        mctp_i3c_ext_param i3c_ext_param;
    };
} mctp_medium_ext_param;

/* mctp recevice data callback function prototype */
/* medium_ext_params shoule be bypass to mctp_send_msg if need */
typedef uint8_t (*mctp_fn_cb)(void *mctp_p, uint8_t src_ep, uint8_t *buf, uint32_t len, mctp_medium_ext_param medium_ext_params);

/* medium write/read function prototype */
typedef uint16_t (*medium_tx)(void *mctp_p, uint8_t *buf, uint32_t len, mctp_medium_ext_param medium_ext_params);
typedef uint16_t (*medium_rx)(void *mctp_p, uint8_t *buf, uint32_t len, mctp_medium_ext_param *medium_ext_params);

/* prototype for destitation endpoint resloved */
typedef uint8_t (*endpoint_resolve)(uint8_t dest_endpoint, void **mctp_inst, mctp_medium_ext_param *medium_ext_params);

/* smbus config for mctp medium_conf */
typedef struct _mctp_i3c_conf {
    uint8_t bus;
    uint8_t addr;
    uint32_t dummy;
} mctp_i3c_conf;

/* smbus config for mctp medium_conf */
typedef struct _mctp_smbus_conf {
    uint8_t bus;
    uint8_t addr;
} mctp_smbus_conf;

/* mctp medium conf */
typedef union {
    mctp_smbus_conf smbus_conf;
    mctp_i3c_conf i3c_conf;
} mctp_medium_conf;

/* mctp tx message struct */
typedef struct _mctp_tx_msg {
    uint8_t is_bridge_packet;
    uint8_t endpoint;
    uint8_t tag_owner;
    uint8_t *buf;
    uint16_t len;
    mctp_medium_ext_param medium_ext_param;
} mctp_tx_msg;

/* mctp main struct */
typedef struct _mctp {
    uint8_t is_servcie_start;
    MCTP_MEDIUM_TYPE medium_type;
    uint8_t endpoint;
    uint16_t max_msg_size;

    /* medium related */
    mctp_medium_conf medium_conf;
    medium_rx read_data;
    medium_tx write_data;
    
    /* get mctp route information by application layer */
    endpoint_resolve ep_resolve;

    /* read/write task */
    osThreadId_t mctp_rx_task_tid;
    osThreadId_t mctp_tx_task_tid;
    uint8_t mctp_rx_task_name[MCTP_TASK_NAME_LEN];
    uint8_t mctp_tx_task_name[MCTP_TASK_NAME_LEN];

    /* write queue */
    osMessageQueueId_t mctp_tx_queue;
    
    /* the callback when recevie mctp data */
    mctp_fn_cb rx_cb;
} mctp;

/* debug util */
static inline void print_data_hex(uint8_t *buf, uint32_t len)
{
    if (!buf || !len)
        return;

    uint16_t i;
    for (i = 0; i < len; i++) {
        if (!(i % 16) && i)
            printk("\n");
        printk("%02X ", *(buf + i));
    }
    printk("\n");
}

/* public function */
mctp *mctp_init(void);

uint8_t mctp_deinit(mctp *mctp_inst);

uint8_t mctp_set_medium_configure(mctp *mctp_inst, MCTP_MEDIUM_TYPE medium_type, mctp_medium_conf medium_conf);

/* medium_conf should be freed by application */
uint8_t mctp_get_medium_configure(mctp *mctp_inst, MCTP_MEDIUM_TYPE *medium_type, mctp_medium_conf *medium_conf);

/* mctp service start */
uint8_t mctp_start(mctp *mctp_inst);

/* mctp service stop */
uint8_t mctp_stop(mctp *mctp_inst);

/* send message to destination endpoint */
uint8_t mctp_send_msg(mctp *mctp_inst, uint8_t dest_ep, uint8_t *buf, uint16_t len, uint8_t tag_owner, mctp_medium_ext_param medium_ext_params);

/* bridge message to destination endpoint */
uint8_t mctp_bridge_msg(mctp *mctp_inst, uint8_t *buf, uint16_t len, mctp_medium_ext_param medium_ext_params);

/* medium init/deinit */
uint8_t mctp_smbus_init(mctp *mctp_inst, mctp_medium_conf medium_conf);
uint8_t mctp_smbus_deinit(mctp *mctp_inst);

/* register endpoint resolve function */
uint8_t mctp_reg_endpoint_resolve_func(mctp *mctp_inst, endpoint_resolve resolve_fn);

/* register callback function when the mctp message is received */
uint8_t mctp_reg_msg_rx_func(mctp *mctp_inst, mctp_fn_cb rx_cb);

#ifdef __cplusplus
}
#endif

#endif /* _PLDM_H */
```

## src/mctp_smbus.c
```c
#include <stdint.h>
#include <stdlib.h>
#include <string.h>
#include <zephyr.h>
#include <sys/printk.h>
#include <sys/crc.h>
#include <cmsis_os2.h>
#include "mctp.h"

#define MCTP_SMBUS_PEC_SIZE 1

#define MCTP_SMBUS_CMD_CODE 0x0F

typedef struct __attribute__((packed)) {
    uint8_t cmd_code;
    uint8_t byte_cnt;
    uint8_t src_addr;
} smbus_hdr;

static uint8_t cal_pec(uint8_t dest_addr, uint8_t *buf, uint32_t len, uint8_t *pec)
{
    if (!buf || !len || !pec)
        return MCTP_ERROR;

    uint8_t pec_buf[len];
    pec_buf[0] = dest_addr;
    memcpy(pec_buf + 1, buf, len - 1);

    print_data_hex(pec_buf, sizeof(pec_buf));

    *pec = crc8(pec_buf, sizeof(pec_buf), 0x07, 0x00, false);
    return MCTP_SUCCESS;
}

static bool is_pec_vaild(uint8_t dest_addr, uint8_t *buf, uint32_t len)
{
    if (!buf || !len)
        return false;
    
    uint8_t pec = 0;
    if (cal_pec(dest_addr, buf, len, &pec) == MCTP_ERROR)
        return false;

    uint8_t exp_pec = buf[len -1];

    if (pec != exp_pec) {
        mctp_printf("pec error dest_addr %x, cal = %x, exp = %x\n", dest_addr, pec, exp_pec);
        print_data_hex(buf, sizeof(len));
    }

    return (pec == exp_pec) ? true : false;
}

static uint8_t make_send_buf(mctp *mctp_inst, uint8_t *send_buf, uint32_t send_len, 
    uint8_t *mctp_data, uint32_t mctp_data_len, mctp_ext_param extra_data)
{
    if (!mctp_inst || !send_buf || !send_len || !mctp_data || !mctp_data_len)
        return MCTP_ERROR;

    smbus_hdr *hdr = (smbus_hdr *)send_buf;
    hdr->cmd_code = MCTP_SMBUS_CMD_CODE;
    hdr->src_addr = mctp_inst->medium_conf.smbus_conf.addr + 1; /* bit 0 always set */
    hdr->byte_cnt = 1 + mctp_data_len; /* extend 1 byte src addr */
    memcpy(send_buf + sizeof(*hdr), mctp_data, mctp_data_len);

    uint8_t pec = 0;
    if (cal_pec(extra_data.smbus_ext_param.addr, send_buf, send_len, &pec) == MCTP_ERROR)
        return MCTP_ERROR;

    send_buf[send_len - 1] = pec;
    return MCTP_SUCCESS;
}

static uint16_t mctp_smbus_read(void *mctp_p, uint8_t *buf, uint32_t len, mctp_ext_param *extra_data)
{
    if (!mctp_p || !buf || !len || !extra_data)
        return 0;

    mctp *mctp_inst = (mctp *)mctp_p;

    uint8_t rdata[256] = {0};
    uint8_t rlen = 0;

    /* TODO: read data from smbus */

    smbus_hdr *hdr = (smbus_hdr *)rdata;

    /* does read data include pec?
     * rlen = 1(mctp cmd code 0x0F) + 1(byte count) + N(byte count) + 1(*pec, if exist)
     * so if rlen is equal N + 3, the pec is existion
     */
    const uint8_t is_pec_exist = ((hdr->byte_cnt + 3) == rlen) ? 1 : 0;

    if (is_pec_exist) {
        if (is_pec_vaild(mctp_inst->medium_conf.smbus_conf.addr, rdata, rlen) == false)
            return 0;
    }

    if (hdr->cmd_code != MCTP_SMBUS_CMD_CODE)
        return 0;
    
    extra_data->type = MCTP_MEDIUM_TYPE_SMBUS;
    extra_data->smbus_ext_param.addr = hdr->src_addr;

    uint8_t rt_size = rlen - sizeof(smbus_hdr) - is_pec_exist;
    memcpy(buf, rdata + sizeof(smbus_hdr), rt_size);
    // return rt_size;
    return 0;
}

static uint16_t mctp_smbus_write(void *mctp_p, uint8_t *buf, uint32_t len, mctp_ext_param extra_data)
{
    if (!mctp_p || !buf || !len)
        return 0;

    mctp *mctp_inst = (mctp *)mctp_p;

    if (extra_data.type != MCTP_MEDIUM_TYPE_SMBUS)
        return 0;
    
    if (MCTP_DEBUG)
        print_data_hex(buf, len);

    /* send len = 1(mctp cmd code 0x0F) + 1(byte count) + 1(src addr) + len(mctp data) + 1(*pec, if exist) */
    uint32_t send_len = len + 4;
    uint8_t send_buf[send_len];
    uint8_t rc = make_send_buf(mctp_inst, send_buf, send_len, buf, len, extra_data);
    if (rc == MCTP_ERROR) {
        mctp_printf("make send buf failed!!\n");
        return 0;
    }

    if (MCTP_DEBUG) {
        mctp_printf("smbus_ext_param addr = %x\n", extra_data.smbus_ext_param.addr);
        mctp_printf("send packet =====================\n");
        print_data_hex(send_buf, send_len);
    }
    
    /* TODO: write data to smbus */

    /* TODO: return the actually write data len */
    return 1;
}

uint8_t mctp_smbus_init(mctp *mctp_inst, mctp_medium_conf medium_conf)
{
    if (!mctp_inst)
        return MCTP_ERROR;

    mctp_inst->medium_conf = medium_conf;
    mctp_inst->read_data = mctp_smbus_read;
    mctp_inst->write_data = mctp_smbus_write;

    return MCTP_SUCCESS; 
}

uint8_t mctp_smbus_deinit(mctp *mctp_inst)
{
    if (!mctp_inst)
        return MCTP_ERROR;

    mctp_inst->read_data = NULL;
    mctp_inst->write_data = NULL;
    memset(&mctp_inst->medium_conf, 0, sizeof(mctp_inst->medium_conf));
    return MCTP_SUCCESS; 
}
```

## src/pldm.c
```c
#include <zephyr.h>
#include <sys/printk.h>
#include <cmsis_os2.h>
#include "mctp.h"
#include "pldm.h"

/* commands of pldm type 0x00 : PLDM_TYPE_CTRL_DISCOV */
#define PLDM_CTRL_DISCOV_CMD_CODE_SETTID 0x01
#define PLDM_CTRL_DISCOV_CMD_CODE_GETTID 0x02
#define PLDM_CTRL_DISCOV_CMD_CODE_GET_PLDM_VER 0x03
#define PLDM_CTRL_DISCOV_CMD_CODE_GET_PLDM_TYPE 0x04
#define PLDM_CTRL_DISCOV_CMD_CODE_GET_PLDM_CMDS 0x05

typedef enum {
    PLDM_TYPE_CTRL_DISCOV = 0x00,
    PLDM_TYPE_SMBIOS,
    PLDM_TYPE_PLAT_MON_CTRL,
    PLDM_TYPE_BIOS_CTRL_CONF,
    PLDM_TYPE_FW_UPDATE = 0x05
} PLDM_TYPE;

typedef struct __attribute__((packed)) {
    union {
        struct {
            uint8_t inst_id : 5;
            uint8_t rsvd : 1;
            uint8_t d : 1;
            uint8_t rq : 1;
        };
        uint8_t req_d_id;
    };
    
    uint8_t pldm_type : 6;
    uint8_t ver : 2;
    uint8_t cmd;
} pldm_hdr;

uint8_t get_tid(void *mctp_p, uint8_t src_ep, uint8_t *buf, uint32_t len, mctp_medium_ext_param medium_ext_params)
{
    mctp_printf("\n");
    return MCTP_SUCCESS;
}

typedef struct _cmd_handler {
    uint8_t cmd_code;
    mctp_fn_cb fn;
} cmd_handler;

static cmd_handler pldm_ctrl_discov_table[] ={
    {PLDM_CTRL_DISCOV_CMD_CODE_GETTID, get_tid},
    {0xFF, NULL}
};

uint8_t pldm_cmd_handler(void *mctp_p, uint8_t src_ep, uint8_t *buf, uint32_t len, mctp_medium_ext_param medium_ext_params)
{
	mctp_printf("\n");
	if (!mctp_p || !buf || !len)
		return MCTP_ERROR;

    pldm_hdr *hdr = (pldm_hdr *)buf;
    mctp_printf("sizeof(pldm_hdr) = %x\n", sizeof(pldm_hdr));
    mctp_printf("req_d_id = 0x%x\n", hdr->req_d_id);
    mctp_printf("pldm_type = 0x%x\n", hdr->pldm_type);
    mctp_printf("ver = 0x%x\n", hdr->ver);
    mctp_printf("cmd = 0x%x\n", hdr->cmd);

    cmd_handler *cmd_p = NULL;
    switch (hdr->pldm_type) {
    case PLDM_TYPE_CTRL_DISCOV:
        cmd_p = pldm_ctrl_discov_table;
        break;
    default:
        break;
    }

    if (!cmd_p)
        return MCTP_ERROR;

    uint8_t i;
    for (i = 0; ; i++) {
        if ((cmd_p + i)->cmd_code == 0xFF)
            break;

        if ((cmd_p + i)->cmd_code != hdr->cmd)
            continue;

        if ((cmd_p + i)->fn)
            (cmd_p + i)->fn(mctp_p, src_ep, buf, len, medium_ext_params);
        break;
    }

	return MCTP_SUCCESS;
}
```

## src/pldm.h
```c
#ifndef _PLDM_H
#define _PLDM_H

#ifdef __cplusplus
extern "C" {
#endif

#include <stdint.h>
#include <sys/printk.h>
#include <zephyr.h>
#include <cmsis_os2.h>
#include "mctp.h"

uint8_t pldm_cmd_handler(void *mctp_p, uint8_t src_ep, uint8_t *buf, uint32_t len, mctp_medium_ext_param medium_ext_params);

#ifdef __cplusplus
}
#endif

#endif /* _PLDM_H */
```
